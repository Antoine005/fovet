/*
 * Fovet SDK — Sentinelle
 * Copyright (C) 2026 Antoine Porte. All rights reserved.
 * LGPL v3 for non-commercial use.
 * Commercial licensing: contact@fovet.eu
 */

/*
 * Integration test: Forge-exported header → Sentinelle runtime
 *
 * Verifies that a FovetZScore struct pre-calibrated by Fovet Forge compiles
 * and behaves correctly at runtime against the edge-core library.
 *
 * Compile:
 *   gcc -std=c99 -Wall -O2 \
 *       -I../include \
 *       -I../../automl-pipeline/models/demo_zscore \
 *       -DFOVET_NATIVE_TEST \
 *       -o test_forge_integration \
 *       ../src/zscore.c test_forge_integration.c -lm
 *
 * The -I path points to the directory containing fovet_zscore_config.h
 * generated by: uv run forge run --config configs/demo_zscore.yaml
 */

#include <stdio.h>
#include <stdlib.h>
#include <math.h>
#include <stdbool.h>
#include <stdint.h>

/* Pull in the Forge-exported calibration */
#include "fovet_zscore_config.h"

/* -------------------------------------------------------------------------
 * Minimal test framework (same as test_zscore.c)
 * ------------------------------------------------------------------------- */

static int g_pass = 0;
static int g_fail = 0;

#define ASSERT(cond, msg)                                               \
    do {                                                                \
        if (cond) {                                                     \
            printf("[PASS] %s\n", msg);                                 \
            g_pass++;                                                   \
        } else {                                                        \
            printf("[FAIL] %s  (line %d)\n", msg, __LINE__);           \
            g_fail++;                                                   \
        }                                                               \
    } while (0)

#define ASSERT_FLOAT_EQ(a, b, tol, msg)                                \
    ASSERT(fabsf((a) - (b)) < (tol), msg)

/* -------------------------------------------------------------------------
 * Expected values — read directly from the Forge-generated struct so these
 * tests remain valid regardless of which demo_zscore config was used (n_samples
 * and train/test split ratio both affect count, mean, M2).
 * The structural invariants we verify are config-independent.
 * ------------------------------------------------------------------------- */

#define EXPECTED_THRESHOLD  (3.000000f)

static void test_precalibrated_struct_values(void)
{
    /* The struct is defined in fovet_zscore_config.h by Forge */
    ASSERT(fovet_zscore_value.count > 0U,
           "forge: pre-loaded count > 0");
    ASSERT_FLOAT_EQ(fovet_zscore_value.threshold_sigma, EXPECTED_THRESHOLD, 1e-4f,
                    "forge: threshold_sigma == 3.0");
    ASSERT(fovet_zscore_value.M2 > 0.0f,
           "forge: M2 > 0 (calibrated on non-constant signal)");
    ASSERT(fovet_zscore_value.min_samples == 0U,
           "forge: min_samples == 0 (pre-calibrated, no warm-up)");
}

static void test_precalibrated_mean_and_stddev(void)
{
    /* Use a copy so we don't mutate the static const from the header */
    FovetZScore ctx = fovet_zscore_value;

    float mean   = fovet_zscore_get_mean(&ctx);
    float stddev = fovet_zscore_get_stddev(&ctx);

    /* Values must be finite and stddev must be positive */
    ASSERT(stddev > 0.0f,            "forge: stddev > 0");
    ASSERT(mean == mean,             "forge: mean is not NaN");  /* NaN check */
    /* Sine wave centred near 0 with unit noise → |mean| < 0.5, stddev ≈ 0.7–1.5 */
    ASSERT(mean > -0.5f && mean < 0.5f, "forge: mean in [-0.5, 0.5] for sine signal");
    ASSERT(stddev > 0.5f && stddev < 2.0f, "forge: stddev in [0.5, 2.0] for sine signal");
}

static void test_precalibrated_fires_immediately_no_warmup(void)
{
    FovetZScore ctx = fovet_zscore_value;

    /*
     * mean ~ -0.031, stddev ~ 1.065, threshold = 3σ
     * A normal sample near the mean must NOT trigger
     */
    bool result = fovet_zscore_update(&ctx, 0.0f);
    ASSERT(!result, "forge: normal sample near mean does not trigger");
}

static void test_precalibrated_detects_large_anomaly(void)
{
    FovetZScore ctx     = fovet_zscore_value;
    float cal_mean      = fovet_zscore_get_mean(&ctx);
    float cal_stddev    = fovet_zscore_get_stddev(&ctx);

    /* Inject a 6σ spike — must be flagged on first call (no warm-up) */
    float spike = cal_mean + 6.0f * cal_stddev;
    bool result = fovet_zscore_update(&ctx, spike);
    ASSERT(result, "forge: 6-sigma spike detected on first call (no warm-up)");
}

static void test_precalibrated_normal_stream_no_false_positives(void)
{
    FovetZScore ctx     = fovet_zscore_value;
    float cal_mean      = fovet_zscore_get_mean(&ctx);
    float cal_stddev    = fovet_zscore_get_stddev(&ctx);

    /* Feed 200 normal samples (within ±2σ of mean) — should not trigger */
    int alert_count = 0;
    for (int i = 0; i < 200; i++) {
        float noise  = ((float)(i % 11) - 5.0f) * (cal_stddev * 0.35f);
        float sample = cal_mean + noise;
        if (fovet_zscore_update(&ctx, sample)) {
            alert_count++;
        }
    }
    ASSERT(alert_count == 0,
           "forge: 200 normal samples produce no false positives");
}

static void test_precalibrated_detects_injected_spike_in_stream(void)
{
    FovetZScore ctx     = fovet_zscore_value;
    float cal_mean      = fovet_zscore_get_mean(&ctx);
    float cal_stddev    = fovet_zscore_get_stddev(&ctx);

    /* 100 normal samples, then a +5σ spike */
    for (int i = 0; i < 100; i++) {
        float noise = ((float)(i % 11) - 5.0f) * (cal_stddev * 0.2f);
        fovet_zscore_update(&ctx, cal_mean + noise);
    }

    float spike  = cal_mean + 5.0f * cal_stddev;
    bool  result = fovet_zscore_update(&ctx, spike);
    ASSERT(result, "forge: 5-sigma spike detected in normal stream");
}

/* -------------------------------------------------------------------------
 * Entry point
 * ------------------------------------------------------------------------- */

int main(void)
{
    printf("=== Fovet Forge → Sentinelle Integration Tests ===\n");
    printf("    Config: demo_zscore (sine, 1000 samples, 3σ)\n\n");

    test_precalibrated_struct_values();
    test_precalibrated_mean_and_stddev();
    test_precalibrated_fires_immediately_no_warmup();
    test_precalibrated_detects_large_anomaly();
    test_precalibrated_normal_stream_no_false_positives();
    test_precalibrated_detects_injected_spike_in_stream();

    printf("\n=== Results: %d passed, %d failed ===\n", g_pass, g_fail);
    return (g_fail == 0) ? EXIT_SUCCESS : EXIT_FAILURE;
}
